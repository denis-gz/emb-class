## cmake-template/main/Kconfig.projbuild
```kconfig
menu "Project Configuration"

    orsource "Kconfig.env_caps"

    config PIN_DEVKIT_BUTTON
        int "Pin number of Devkit's on-board button"
        range ENV_GPIO_RANGE_MIN ENV_GPIO_OUT_RANGE_MAX
        default 0

    config PIN_USER_BUTTON
        int "Pin number of user's attached button"
        range ENV_GPIO_RANGE_MIN ENV_GPIO_OUT_RANGE_MAX
        default 4

    config PIN_LED_1
        int "Pin number of LED_1 (pull-up, active low)"
        range ENV_GPIO_RANGE_MIN ENV_GPIO_OUT_RANGE_MAX
        default 6

endmenu
```

## lesson-22-espidf/main/Kconfig.projbuild
```kconfig
menu "Project Configuration"

    orsource "Kconfig.env_caps"

    config PIN_DEVKIT_BUTTON
        int "Pin number of Devkit's on-board button"
        range ENV_GPIO_RANGE_MIN ENV_GPIO_OUT_RANGE_MAX
        default 0

    config PIN_USER_BUTTON
        int "Pin number of user's attached button"
        range ENV_GPIO_RANGE_MIN ENV_GPIO_OUT_RANGE_MAX
        default 4

endmenu
```

## lesson-30-ledc/main/Kconfig.projbuild
```kconfig
menu "Project Configuration"

    orsource "Kconfig.env_caps"

    config PIN_DEVKIT_BUTTON
        int "Pin number of Devkit's on-board button"
        range ENV_GPIO_RANGE_MIN ENV_GPIO_OUT_RANGE_MAX
        default 0

    config PIN_USER_BUTTON
        int "Pin number of user's attached button"
        range ENV_GPIO_RANGE_MIN ENV_GPIO_OUT_RANGE_MAX
        default 0

    config PIN_LED_1
        int "Pin number of LED_1 output (pull-up, active low)"
        range ENV_GPIO_RANGE_MIN ENV_GPIO_OUT_RANGE_MAX
        default 12

    config PIN_SERVO_1
        int "Pin number of SERVO_1 output (SG90)"
        range ENV_GPIO_RANGE_MIN ENV_GPIO_OUT_RANGE_MAX
        default 1

    config PIN_ADC_INPUT_1
        int "Pin number of RP1 voltage divider input (LED control)"
        range ENV_GPIO_RANGE_MIN ENV_GPIO_OUT_RANGE_MAX
        default 4

    config PIN_ADC_INPUT_2
        int "Pin number of RP2 voltage divider input (SERVO control)"
        range ENV_GPIO_RANGE_MIN ENV_GPIO_OUT_RANGE_MAX
        default 5

    config SMA_WINDOW_SIZE
        int "Sliding window size of averaging filter"
        range 2 256
        default 10

endmenu
```

## lesson-33-encoder+led/main/Kconfig.projbuild
```kconfig
menu "Project Configuration"

    orsource "Kconfig.env_caps"

    config PIN_DEVKIT_BUTTON
        int "Pin number of Devkit's on-board button"
        range ENV_GPIO_RANGE_MIN ENV_GPIO_OUT_RANGE_MAX
        default 0

    config PIN_ENCODER_S1
        int "Pin number of rotary encoder output S1 (counter)"
        range ENV_GPIO_RANGE_MIN ENV_GPIO_OUT_RANGE_MAX
        default 0

    config PIN_ENCODER_S2
        int "Pin number of rotary encoder output S2 (direction)"
        range ENV_GPIO_RANGE_MIN ENV_GPIO_OUT_RANGE_MAX
        default 0

    config PIN_ENCODER_KEY
        int "Pin number of rotary encoder key output"
        range ENV_GPIO_RANGE_MIN ENV_GPIO_OUT_RANGE_MAX
        default 0

    config PIN_LED_SEG_A
        int "Pin number of LED display segment A"
        range ENV_GPIO_RANGE_MIN ENV_GPIO_OUT_RANGE_MAX
        default 0

    config PIN_LED_SEG_B
        int "Pin number of LED display segment B"
        range ENV_GPIO_RANGE_MIN ENV_GPIO_OUT_RANGE_MAX
        default 0

    config PIN_LED_SEG_C
        int "Pin number of LED display segment C"
        range ENV_GPIO_RANGE_MIN ENV_GPIO_OUT_RANGE_MAX
        default 0

    config PIN_LED_SEG_D
        int "Pin number of LED display segment D"
        range ENV_GPIO_RANGE_MIN ENV_GPIO_OUT_RANGE_MAX
        default 0

    config PIN_LED_SEG_E
        int "Pin number of LED display segment E"
        range ENV_GPIO_RANGE_MIN ENV_GPIO_OUT_RANGE_MAX
        default 0

    config PIN_LED_SEG_F
        int "Pin number of LED display segment F"
        range ENV_GPIO_RANGE_MIN ENV_GPIO_OUT_RANGE_MAX
        default 0

    config PIN_LED_SEG_G
        int "Pin number of LED display segment G"
        range ENV_GPIO_RANGE_MIN ENV_GPIO_OUT_RANGE_MAX
        default 0

    config PIN_LED_SEG_DP
        int "Pin number of LED display segment DP"
        range ENV_GPIO_RANGE_MIN ENV_GPIO_OUT_RANGE_MAX
        default 0

    config PIN_LED_DIG1
        int "Pin number of LED display common anode DIG1"
        range ENV_GPIO_RANGE_MIN ENV_GPIO_OUT_RANGE_MAX
        default 0

    config PIN_LED_DIG2
        int "Pin number of LED display common anode DIG2"
        range ENV_GPIO_RANGE_MIN ENV_GPIO_OUT_RANGE_MAX
        default 0

    config PIN_LED_DIG3
        int "Pin number of LED display common anode DIG3"
        range ENV_GPIO_RANGE_MIN ENV_GPIO_OUT_RANGE_MAX
        default 0

endmenu
```

## lesson-38-uart-slave/main/Kconfig.projbuild
```kconfig
menu "Project Configuration"

    orsource "Kconfig.env_caps"

    config PIN_DEVKIT_BUTTON
        int "Pin number of Devkit's on-board button"
        range ENV_GPIO_RANGE_MIN ENV_GPIO_OUT_RANGE_MAX
        default 0

    config UART_NUM
        int "UART device number"
        range 0 1
        default 0

    config PIN_UART_RX
        int "Pin number of UART RX line"
        range ENV_GPIO_RANGE_MIN ENV_GPIO_OUT_RANGE_MAX
        default 0

    config PIN_UART_TX
        int "Pin number of UART TX line"
        range ENV_GPIO_RANGE_MIN ENV_GPIO_OUT_RANGE_MAX
        default 0

    config PIN_LED_SEG_A
        int "Pin number of LED display segment A"
        range ENV_GPIO_RANGE_MIN ENV_GPIO_OUT_RANGE_MAX
        default 0

    config PIN_LED_SEG_B
        int "Pin number of LED display segment B"
        range ENV_GPIO_RANGE_MIN ENV_GPIO_OUT_RANGE_MAX
        default 0

    config PIN_LED_SEG_C
        int "Pin number of LED display segment C"
        range ENV_GPIO_RANGE_MIN ENV_GPIO_OUT_RANGE_MAX
        default 0

    config PIN_LED_SEG_D
        int "Pin number of LED display segment D"
        range ENV_GPIO_RANGE_MIN ENV_GPIO_OUT_RANGE_MAX
        default 0

    config PIN_LED_SEG_E
        int "Pin number of LED display segment E"
        range ENV_GPIO_RANGE_MIN ENV_GPIO_OUT_RANGE_MAX
        default 0

    config PIN_LED_SEG_F
        int "Pin number of LED display segment F"
        range ENV_GPIO_RANGE_MIN ENV_GPIO_OUT_RANGE_MAX
        default 0

    config PIN_LED_SEG_G
        int "Pin number of LED display segment G"
        range ENV_GPIO_RANGE_MIN ENV_GPIO_OUT_RANGE_MAX
        default 0

    config PIN_LED_SEG_DP
        int "Pin number of LED display segment DP"
        range ENV_GPIO_RANGE_MIN ENV_GPIO_OUT_RANGE_MAX
        default 0

    config PIN_LED_DIG1
        int "Pin number of LED display common anode DIG1"
        range ENV_GPIO_RANGE_MIN ENV_GPIO_OUT_RANGE_MAX
        default 0

    config PIN_LED_DIG2
        int "Pin number of LED display common anode DIG2"
        range ENV_GPIO_RANGE_MIN ENV_GPIO_OUT_RANGE_MAX
        default 0

    config PIN_LED_DIG3
        int "Pin number of LED display common anode DIG3"
        range ENV_GPIO_RANGE_MIN ENV_GPIO_OUT_RANGE_MAX
        default 0

endmenu
```

## lesson-39-i2c-oled/main/Kconfig.projbuild
```kconfig
menu "Project Configuration"

    orsource "Kconfig.env_caps"

    config PIN_DEVKIT_BUTTON
        int "Pin number of Devkit's on-board button"
        range ENV_GPIO_RANGE_MIN ENV_GPIO_OUT_RANGE_MAX
        default 0

    config PIN_ENCODER_S1
        int "Pin number of rotary encoder S1 output (counter)"
        range ENV_GPIO_RANGE_MIN ENV_GPIO_OUT_RANGE_MAX
        default 0

    config PIN_ENCODER_S2
        int "Pin number of rotary encoder S2 output (direction)"
        range ENV_GPIO_RANGE_MIN ENV_GPIO_OUT_RANGE_MAX
        default 0

    config PIN_ENCODER_KEY
        int "Pin number of rotary encoder key output"
        range ENV_GPIO_RANGE_MIN ENV_GPIO_OUT_RANGE_MAX
        default 0

    config PIN_I2C_SCL
        int "Pin number of I2C SCL line"
        range ENV_GPIO_RANGE_MIN ENV_GPIO_OUT_RANGE_MAX
        default 0

    config PIN_I2C_SDA
        int "Pin number of I2C SDA line"
        range ENV_GPIO_RANGE_MIN ENV_GPIO_OUT_RANGE_MAX
        default 0

    config I2C_SSD1306_ADDR
		hex "Slave address of SSD1306 display device on I2C bus"
        range ENV_I2C_ADDR_RANGE_MIN ENV_I2C_ADDR_RANGE_MAX
        default ENV_I2C_ADDR_RANGE_MIN

    config I2C_BMP280_ADDR
		hex "Slave address of BMP280 temperature/humidity/pressure device on I2C bus"
        range ENV_I2C_ADDR_RANGE_MIN ENV_I2C_ADDR_RANGE_MAX
        default ENV_I2C_ADDR_RANGE_MIN

    config I2C_DS1307_ADDR
		hex "Slave address of DS1307 RTC device on I2C bus"
        range ENV_I2C_ADDR_RANGE_MIN ENV_I2C_ADDR_RANGE_MAX
        default ENV_I2C_ADDR_RANGE_MIN

    config I2C_AT24C32_ADDR
		hex "Slave address of AT24C32 flash memory device on I2C bus"
        range ENV_I2C_ADDR_RANGE_MIN ENV_I2C_ADDR_RANGE_MAX
        default ENV_I2C_ADDR_RANGE_MIN

    config PIN_LED_SEG_A
        int "Pin number of LED display segment A"
        range ENV_GPIO_RANGE_MIN ENV_GPIO_OUT_RANGE_MAX
        default 0

    config PIN_LED_SEG_B
        int "Pin number of LED display segment B"
        range ENV_GPIO_RANGE_MIN ENV_GPIO_OUT_RANGE_MAX
        default 0

    config PIN_LED_SEG_C
        int "Pin number of LED display segment C"
        range ENV_GPIO_RANGE_MIN ENV_GPIO_OUT_RANGE_MAX
        default 0

    config PIN_LED_SEG_D
        int "Pin number of LED display segment D"
        range ENV_GPIO_RANGE_MIN ENV_GPIO_OUT_RANGE_MAX
        default 0

    config PIN_LED_SEG_E
        int "Pin number of LED display segment E"
        range ENV_GPIO_RANGE_MIN ENV_GPIO_OUT_RANGE_MAX
        default 0

    config PIN_LED_SEG_F
        int "Pin number of LED display segment F"
        range ENV_GPIO_RANGE_MIN ENV_GPIO_OUT_RANGE_MAX
        default 0

    config PIN_LED_SEG_G
        int "Pin number of LED display segment G"
        range ENV_GPIO_RANGE_MIN ENV_GPIO_OUT_RANGE_MAX
        default 0

    config PIN_LED_SEG_DP
        int "Pin number of LED display segment DP"
        range ENV_GPIO_RANGE_MIN ENV_GPIO_OUT_RANGE_MAX
        default 0

    config PIN_LED_DIG1
        int "Pin number of LED display common anode DIG1"
        range ENV_GPIO_RANGE_MIN ENV_GPIO_OUT_RANGE_MAX
        default 0

    config PIN_LED_DIG2
        int "Pin number of LED display common anode DIG2"
        range ENV_GPIO_RANGE_MIN ENV_GPIO_OUT_RANGE_MAX
        default 0

    config PIN_LED_DIG3
        int "Pin number of LED display common anode DIG3"
        range ENV_GPIO_RANGE_MIN ENV_GPIO_OUT_RANGE_MAX
        default 0

endmenu
```
